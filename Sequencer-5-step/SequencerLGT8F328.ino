// For LGT8F328 Nano - style

int analogueReadings[] = { -1, -1, -1, -1, -1, -1 };
int jitterThreshold = 14;

byte analoguePins[] = { A7, A6, A5, A4, A3, A2 };
byte readAnaloguePin = 0;

byte stepLedPins[] = { 5, 6, 7, 8, 9 };

byte stepCountPins[] = { 11, 10 };

// Using analogue pins means that clock and reset could be recoded for CVs
byte stepPin = A1;
bool prevStepState = false;

//byte resetPin = A0;
//bool prevResetState = false;

byte notes[] = { 0, 0, 0, 0, 0 };

float scaleRange = 0;

byte chosenScale = 0;

const uint8_t scaleNotes[16][128] PROGMEM = {
  // chromatic
  { 0, 1, 2, 3, 4, 5, 6, 7, 8, 9, 10, 11, 12,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 126, 127 },
  // dorian
  { 0, 1, 3, 5, 7, 8, 10, 12, 13, 15, 17, 19, 20,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 120, 121 },
  // phrygian
  { 0, 2, 4, 6, 7, 9, 11, 12, 14, 16, 18, 19, 21,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 120, 122 },
  // lydian
  { 0, 2, 4, 5, 7, 9, 10, 12, 14, 16, 17, 19, 21,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 120, 122 },
  // mixolydian
  { 0, 2, 3, 5, 7, 8, 10, 12, 14, 15, 17, 19, 20,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 120, 122 },
  // aeolian
  { 0, 1, 3, 5, 6, 8, 10, 12, 13, 15, 17, 18, 20,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 120, 121 },
  // locrian
  { 0, 2, 4, 5, 7, 9, 11, 12, 14, 16, 17, 19, 21,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 120, 122 },
  // lydian_domiant
  { 0, 2, 4, 5, 7, 8, 10, 12, 14, 16, 17, 19, 20,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 120, 122 },
  // super_locrian
  { 0, 2, 3, 5, 7, 9, 11, 12, 14, 15, 17, 19, 21,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 120, 122 },
  // hirajoshi
  { 0, 1, 5, 6, 10, 12, 13, 17, 18, 22, 24, 25, 29,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 109, 113 },
  // minor_pentatonic
  { 0, 2, 4, 7, 9, 12, 14, 16, 19, 21, 24, 26, 28,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 110, 112 },
  // major_pentatonic
  { 0, 2, 5, 7, 10, 12, 14, 17, 19, 22, 24, 26, 29,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 110, 113 },
  // minor_blues
  { 0, 2, 3, 4, 7, 9, 12, 14, 15, 16, 19, 21, 24,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 108, 110 },
  // major_blues
  { 0, 1, 2, 5, 7, 10, 12, 13, 14, 17, 19, 22, 24,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 108, 109 },
  // whole_half_diminished
  { 0, 1, 3, 4, 6, 7, 9, 10, 12, 13, 15, 16, 18,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 117, 118 },
  // half_whole_diminished
  { 0, 2, 3, 5, 6, 8, 9, 11, 12, 14, 15, 17, 18,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 117, 119 },
};

byte noteCounter = 0;
byte totalNotes = 5;

unsigned long lastChangedNote = 0;
int changeNote = 125;

void setup() {
  analogReference(DEFAULT);
  pinMode(DAC0, ANALOG);
  // use 6.8k + 120R scaling resistor.
  // Actual resistance measured was 6.85k .
  // Due to 0.023V offset,
  // the DAC can't quite reach note 60 because that would need to reach 5.023V
  // Approx formula for note 59 = (59 * (1/12)) + 0.023 = 4.93966666667

  for(int i = 0; i < 6; i++){
    pinMode(analoguePins[i], INPUT);
  }

  for(int i = 0; i < 5; i++){
    pinMode(stepLedPins[i], OUTPUT);
  }

  for(int i = 0; i < 2; i++){
    pinMode(stepCountPins[i], INPUT_PULLUP);
  }

  pinMode(stepPin, INPUT);
  //pinMode(resetPin, INPUT);

  updateOutputs();
}

void loop() {

  if(!digitalRead(stepCountPins[0])){
    totalNotes = 3;
  }else if(!digitalRead(stepCountPins[1])){
    totalNotes = 5;
  }else{
    totalNotes = 4;
  }

  int analogueReading = analogRead(analoguePins[readAnaloguePin]);
  if(abs(analogueReading - analogueReadings[readAnaloguePin]) > jitterThreshold){
    analogueReadings[readAnaloguePin] = analogueReading;

    if(readAnaloguePin == 5){

      int scale63 = analogueReading >> 4;

      int rangeSelection = (scale63 >> 4) + 1;

      chosenScale = scale63 % 16;

      scaleRange = (float)rangeSelection / 4.0f;

      Serial.print(analogueReading);
      Serial.print("\t");
      Serial.print(chosenScale);
      Serial.print("\t");
      Serial.println(rangeSelection);

    }else{

      notes[readAnaloguePin] = analogueReading >> 4;
      if(notes[readAnaloguePin] > 59){
        notes[readAnaloguePin] = 59;
      }

    }
  }
  readAnaloguePin++;
  if(readAnaloguePin >= 6){
    readAnaloguePin = 0;
  }

  bool stepState = digitalRead(stepPin);
  if(stepState && !prevStepState){

    noteCounter++;
    if(noteCounter >= totalNotes){
      noteCounter = 0;
    }

    updateOutputs();

  }
  prevStepState = stepState;

  /*bool resetState = digitalRead(resetPin);
  if(resetState && !prevResetState){

    noteCounter = 0;

    updateOutputs();

  }
  prevResetState = resetState;*/

}

void updateOutputs(){

  int note = round(notes[noteCounter] * scaleRange);

  if(note < 0){
    note = 0;
  }else if(note > 59){
    note = 59;
  }

  byte scaleNote = pgm_read_byte(&(scaleNotes[chosenScale][note]));

  while (scaleNote > 59){

    note-=1;

    scaleNote = pgm_read_byte(&(scaleNotes[chosenScale][note]));

  }

  analogWrite(DAC0, scaleNote * 4);

  for(int i = 0; i < 5; i++){
    digitalWrite(stepLedPins[i], i == noteCounter);
  }

}
