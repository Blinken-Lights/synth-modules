/*
for 8 - Bit Waves
*/

int wave_type = 3;

int pwm = 65536;

int interrupt_frequency = 65536;
int base_octave_value = 122;

int numSamples = 0;
unsigned long t = 0;
unsigned long t0 = 0;

byte bit_shift = 2;
byte bit_shift_tri = bit_shift + 5;
byte bit_shift_saw = bit_shift + 6;

unsigned int segment_times_4 = 0;
unsigned int next_wave_segment_times_4 = 0;
unsigned int wave_segment = 0;
unsigned int segments_per_wave = 16384; //just the length of the segment array - the resolution of the approximation to a perfect wave
const byte wave_segments[] PROGMEM = {127,127,127,127,127,127,127,127,127,127,127,128,128,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127,127};
unsigned int sample_rate = 4; //sample_rate = interrupt_frequency / segments_per_wave;
unsigned long half_wave = 32768;

int sensorPin = A0;
int sensorValue = 0;

int wave_type_selector = A1;

int pwm_cv = A2;
int pwm_sensorValue = 0;
unsigned int EMA_PWM = 0;

int octave_pin = A3;
int octave = 0;
int prev_octave = 0;

int freq_pin = A4;
int freq_value = 0;
unsigned int EMA_freq = 0;

unsigned int total_freq = 0;

bool syncstate = false;
bool prevsyncstate = false;
int sync = 9;

bool lfo = false;
bool prev_lfo = false;
int lfo_pin = 8;

bool quantised = false;
int quantised_pin = 10;

bool gate = true;
int gate_pin = 11;
float envelope = 1.0;
int output_value = 0;

unsigned int frequency = 0;
unsigned int last_frequency = 0;
float EMA_a = 0.1;
float EMA_f = 0.01; // lower = slower response
unsigned int EMA_S = 0;

const unsigned int adc_to_frequency[] PROGMEM = {55,55,55,56,56,56,56,56,57,57,57,57,57,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1754,1760};

const unsigned int adc_to_quantised_frequency[] PROGMEM = {55,55,55,55,55,55,55,55,55,58,58,58,58,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1760,1760};

void setup() {
  
  EMA_S = analogRead(sensorPin);
  EMA_PWM = analogRead(pwm_cv);
  EMA_freq = analogRead(freq_pin);
  
  cli();
  
  TCCR1A = 0;// set entire TCCR2A register to 0
  TCCR1B = 0;// same for TCCR2B
  TCNT1  = 0;//initialize counter value to 0
  OCR1A = 243; //65536Hz: [ 16,000,000Hz / (prescaler * desired interrupt frequency) ] - 1 (must be <65536) = for no prescaler,  [(16*10^6) / (65536 * 1)] - 1 = 243.1
  // also for prescaler of 8 = [(16*10^6) / (65536 * 8)] - 1 = 29.5 - more error than no prescaler
  // turn on CTC mode
  TCCR1B |= (1 << WGM12);
  // No prescaler
  TCCR1B |= (1 << CS10);   
  // enable timer compare interrupt
  TIMSK1 |= (1 << OCIE1A);

  sei();
  
  pinMode(0, OUTPUT);
  pinMode(1, OUTPUT);
  pinMode(2, OUTPUT);
  pinMode(3, OUTPUT);
  pinMode(4, OUTPUT);
  pinMode(5, OUTPUT);
  pinMode(6, OUTPUT);
  pinMode(7, OUTPUT);

  pinMode(sync, INPUT_PULLUP);
  pinMode(lfo_pin, INPUT_PULLUP);
  pinMode(quantised_pin, INPUT_PULLUP);
  pinMode(gate_pin, INPUT);
}

ISR(TIMER1_COMPA_vect){

  if(!gate){
      PORTD = 127;
      segment_times_4 = 0;
      return;
  }
  
  segment_times_4+=frequency;//next_wave_segment_times_4;
  
  if(wave_type==3){ //sine
    wave_segment = segment_times_4 >> bit_shift;
    
    PORTD = pgm_read_byte_near(wave_segments + wave_segment);
  }else if(wave_type==2){ //triangle
    if (segment_times_4 < half_wave){
      PORTD = segment_times_4 >> bit_shift_tri;
    }else if (segment_times_4 > half_wave){
      PORTD = (interrupt_frequency-segment_times_4) >> bit_shift_tri;
    }
  }else if(wave_type==1){ //saw
    PORTD = segment_times_4 >> bit_shift_saw;
  }else if(wave_type==0){ //square
    if(segment_times_4 > pwm){
      PORTD = 255;
    }else{
      PORTD = 0;
    }
  }
}

void loop() {

  gate = digitalRead(gate_pin);

  octave = analogRead(octave_pin) >> 8;
  lfo = !digitalRead(lfo_pin);
  if(prev_lfo != lfo
      || octave != prev_octave){
      cli();
  
      TCCR1A = 0;// set entire TCCR2A register to 0
      TCCR1B = 0;// same for TCCR2B
      TCNT1  = 0;//initialize counter value to 0
      
      if(lfo){
          OCR1A = (base_octave_value * pow(2, (4 -octave) + 4)) - 1;// 7812;
      }else{
          OCR1A = (base_octave_value * pow(2, (4 - octave))) - 1;// 243;
      }
      
      TCCR1B |= (1 << WGM12);
      if(lfo){
          TCCR1B |= (1 << CS11); //prescaler of 8
      }else{
          TCCR1B |= (1 << CS10); //no prescaler
      }
      TIMSK1 |= (1 << OCIE1A);
    
      sei();
  }
  prev_lfo = lfo;
  prev_octave = octave;

  wave_type = analogRead(wave_type_selector) >> 8;

  syncstate = digitalRead(sync);
  if(!syncstate && syncstate!=prevsyncstate){
      segment_times_4 = 0;
  }
  prevsyncstate = syncstate;
  
  //pwm = analogRead(pwm_cv) << 6;
  pwm_sensorValue = analogRead(pwm_cv);
  EMA_PWM = (EMA_a * pwm_sensorValue) + ((1-EMA_a)*EMA_PWM);
  pwm = EMA_PWM << 6;
  
  sensorValue = analogRead(sensorPin);
  EMA_S = (EMA_a * sensorValue) + ((1-EMA_a)*EMA_S);

  freq_value = analogRead(freq_pin);
  EMA_freq = (EMA_f * freq_value) + ((1-EMA_f)*EMA_freq);

  total_freq = min(1023, (EMA_S + EMA_freq));

  quantised = !digitalRead(quantised_pin);
  if(quantised){
      EMA_a = 0.2;
      frequency = pgm_read_word_near(adc_to_quantised_frequency + total_freq);
  }else{
      EMA_a = 0.1;
      frequency = pgm_read_word_near(adc_to_frequency + total_freq);
  }
  
  
}
